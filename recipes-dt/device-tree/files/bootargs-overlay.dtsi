/{
	chosen {
		bootargs = "console=ttyPS0,115200n8 earlycon clock_ignore_unused";
		linux,stdout-path = "/amba/serial@ff000000:115200n8";
		stdout-path = "serial0:115200n8";
	};
};

&gem3 {
	phy-handle = <&phyc>;
	phyc: phy@c {
		reg = <0xc>;
		ti,rx-internal-delay = <0x8>;
		ti,tx-internal-delay = <0xa>;
		ti,fifo-depth = <0x1>;
	};
};
